/* Copyright (c) 2014-2015, The Linux Foundation. All rights reserved.
 *
 * This program is free software; you can redistribute it and/or modify
 * it under the terms of the GNU General Public License version 2 and
 * only version 2 as published by the Free Software Foundation.
 *
 * This program is distributed in the hope that it will be useful,
 * but WITHOUT ANY WARRANTY; without even the implied warranty of
 * MERCHANTABILITY or FITNESS FOR A PARTICULAR PURPOSE.  See the
 * GNU General Public License for more details.
 */

/*---------------------------------------------------------------------------
 * This file is autogenerated file using gcdb parser. Please do not edit it.
 * Update input XML file to add a new entry or update variable in this file
 * VERSION = "1.0"
 *---------------------------------------------------------------------------*/
&mdss_mdp {
	dsi_hx8379c_fwvga_video: qcom,mdss_dsi_hx8379c_fwvga_video {
		qcom,mdss-dsi-panel-name = "hx8379c fwvga video mode dsi panel";
		qcom,mdss-dsi-panel-controller = <&mdss_dsi0>;
		qcom,mdss-dsi-panel-type = "dsi_video_mode";
		qcom,mdss-dsi-panel-destination = "display_1";
		qcom,mdss-dsi-panel-framerate = <60>;
		qcom,mdss-dsi-virtual-channel-id = <0>;
		qcom,mdss-dsi-stream = <0>;
		qcom,mdss-dsi-panel-width = <480>;
		qcom,mdss-dsi-panel-height = <854>;
		qcom,mdss-dsi-h-front-porch = <40>;
		qcom,mdss-dsi-h-back-porch = <40>;
		qcom,mdss-dsi-h-pulse-width = <40>;
		qcom,mdss-dsi-h-sync-skew = <0>;
		qcom,mdss-dsi-v-back-porch = <10>;
		qcom,mdss-dsi-v-front-porch = <12>;
		qcom,mdss-dsi-v-pulse-width = <5>;
		qcom,mdss-dsi-h-left-border = <0>;
		qcom,mdss-dsi-h-right-border = <0>;
		qcom,mdss-dsi-v-top-border = <0>;
		qcom,mdss-dsi-v-bottom-border = <0>;
		qcom,mdss-dsi-bpp = <24>;
		qcom,mdss-dsi-color-order = <0>;
		qcom,mdss-dsi-underflow-color = <0xff>;
		qcom,mdss-dsi-border-color = <0>;
		qcom,ulps-enabled;
		qcom,mdss-dsi-on-command = [39 01 00 00 00 00 04 B9 FF 83 79
		39 01 00 00 00 00 11 B1 44 1A 1A 31 31 90 D0 EE 54 80 38 38 F8 22 22 22
		39 01 00 00 00 00 0A B2 80 FE 0F 0D 00 50 11 42 1D
		39 01 00 00 00 00 0B B4 08 6E 08 6E 08 6E 12 86 13 86
		15 01 00 00 00 00 02 D2 77
		39 01 00 00 00 00 1E D3 00 07 00 00 00 0a 0a 32 10 08 00 08 03 62 03 62 00 08 00 08 37 33 0b 0b 27 0B 0B 27 0D
		39 01 00 00 00 00 23 D5 18 18 18 18 18 18 23 22 21 20 01 00 03 02 05 04 07 06 25 24 27 26 18 18 18 18 18 18 18 18 18 18 00 00
		39 01 00 00 00 00 21 D6 18 18 18 18 18 18 24 25 26 27 00 01 06 07 04 05 02 03 22 23 20 21 18 18 18 18 18 18 18 18 18 18
		39 01 00 00 00 00 2B E0 00 0b 13 30 37 3F 2a 3f 09 0c 0e 18 0f 13 14 13 15 07 11 13 17 00 0b 13 30 37 3F 2a 3f 09 0c 0e 18 0f 13 14 13 15 07 11 13 17
		39 01 00 00 00 00 03 B6 10 10
		15 01 00 00 00 00 02 CC 00
		39 01 00 00 00 00 05 C7 00 00 00 C0
		15 01 00 00 00 00 02 35 00
		15 01 00 00 96 00 02 11 00 
		15 01 00 00 14 00 02 29 00];
		qcom,mdss-dsi-off-command = [05 01 00 00 32 00 02 28 00
					05 01 00 00 78 00 02 10 00];
		qcom,mdss-dsi-on-command-state = "dsi_lp_mode";
		qcom,mdss-dsi-off-command-state = "dsi_hs_mode";
		qcom,mdss-dsi-h-sync-pulse = <1>;
		qcom,mdss-dsi-traffic-mode = "burst_mode";
		qcom,mdss-dsi-bllp-eof-power-mode;
		qcom,mdss-dsi-bllp-power-mode;
		qcom,mdss-dsi-lane-0-state;
		qcom,mdss-dsi-lane-1-state;
		qcom,mdss-dsi-panel-timings = [7B 21 1A 00 31 2D 1E 23 2B 03 04 00];
		qcom,mdss-dsi-t-clk-post = <0x20>;
		qcom,mdss-dsi-t-clk-pre = <0x2C>;
		qcom,mdss-dsi-bl-min-level = <1>;
		qcom,mdss-dsi-bl-max-level = <4095>;
		qcom,mdss-dsi-bl-pmic-control-type = "bl_ctrl_pwm";
		qcom,mdss-dsi-bl-pmic-pwm-frequency = <100>;
		qcom,mdss-dsi-bl-pmic-bank-select = <0>;
		//qcom,mdss-dsi-pwm-gpio = <&pm8909_mpps 2 0>;
		qcom,mdss-dsi-dma-trigger = "trigger_sw";
		qcom,mdss-dsi-mdp-trigger = "none";
		qcom,mdss-dsi-reset-sequence = <1 20>, <0 20>, <1 20>;
		qcom,mdss-dsi-lp11-init;
		qcom,mdss-dsi-init-delay-us = <7000>;
	};
};

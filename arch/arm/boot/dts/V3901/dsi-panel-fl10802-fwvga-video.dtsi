/* Copyright (c) 2015, The Linux Foundation. All rights reserved.
 *
 * This program is free software; you can redistribute it and/or modify
 * it under the terms of the GNU General Public License version 2 and
 * only version 2 as published by the Free Software Foundation.
 *
 * This program is distributed in the hope that it will be useful,
 * but WITHOUT ANY WARRANTY; without even the implied warranty of
 * MERCHANTABILITY or FITNESS FOR A PARTICULAR PURPOSE.  See the
 * GNU General Public License for more details.
 */

&mdss_mdp {
	dsi_fl10802_fwvga_video: qcom,mdss_dsi_fl10802_fwvga_video {
		qcom,mdss-dsi-panel-name = "fl10802 fwvga video mode dsi panel";
		qcom,mdss-dsi-panel-controller = <&mdss_dsi0>;
		qcom,mdss-dsi-panel-type = "dsi_video_mode";
		qcom,mdss-dsi-panel-destination = "display_1";
		qcom,mdss-dsi-panel-framerate = <60>;
		qcom,mdss-dsi-virtual-channel-id = <0>;
		qcom,mdss-dsi-stream = <0>;
		qcom,mdss-dsi-panel-width = <480>;
		qcom,mdss-dsi-panel-height = <854>;
		qcom,mdss-dsi-h-front-porch = <45>;
		qcom,mdss-dsi-h-back-porch = <45>;
		qcom,mdss-dsi-h-pulse-width = <12>;
		qcom,mdss-dsi-h-sync-skew = <0>;
		qcom,mdss-dsi-v-back-porch = <10>;
		qcom,mdss-dsi-v-front-porch = <10>;
		qcom,mdss-dsi-v-pulse-width = <3>;
		qcom,mdss-dsi-h-left-border = <0>;
		qcom,mdss-dsi-h-right-border = <0>;
		qcom,mdss-dsi-v-top-border = <0>;
		qcom,mdss-dsi-v-bottom-border = <0>;
		qcom,mdss-dsi-bpp = <24>;
		qcom,mdss-dsi-color-order = <0>;
		qcom,mdss-dsi-underflow-color = <0xff>;
		qcom,mdss-dsi-border-color = <0>;
		qcom,mdss-dsi-on-command = [39 01 00 00 00 00 04 B9 F1 08 01
			39 01 00 00 00 00 05 B1 22 1e 1e 87
			15 01 00 00 00 00 02 B2 22
			39 01 00 00 00 00 09 B3 00 00 06 06 20 20 30 30
			39 01 00 00 00 00 12 BA 31 00 44 25 91 0A 00 00 C1 00 00 00 0D 02 4F B9 EE
			39 01 00 00 00 00 06 E3 04 04 01 01 00
			15 01 00 00 00 00 02 B4 00
			39 01 00 00 00 00 03 B5 05 05
			39 01 00 00 00 00 03 B6 57 43
			39 01 00 00 00 00 03 B8 64 20
			15 01 00 00 00 00 02 CC 00
			15 01 00 00 00 00 02 BC 47
			39 01 00 00 00 00 34 E9 00 00 07 00 00 81 89 12 31 23 23 07 81 80 23 00 00 10 00 00 00 0f 89 13 18 88 88 88 88 88 88 89 02 08 88 88 88 88 88 88 00 00 00 00 00 00 00 00 00 00 00
			39 01 00 00 00 00 17 EA 90 00 00 00 88 02 09 88 88 88 88 88 88 88 13 19 88 88 88 88 88 88
			39 01 00 00 00 00 23 E0 00 13 19 1a 1b 29 32 40 09 10 11 15 18 16 16 12 17 00 13 19 1a 1b 29 32 40 09 10 11 15 18 16 16 12 17
			05 01 00 00 78 00 02 11 00
			05 01 00 00 00 00 02 29 00];
		
		qcom,mdss-dsi-off-command = [05 01 00 00 32 00 02 28 00
					05 01 00 00 78 00 02 10 00];
		qcom,mdss-dsi-on-command-state = "dsi_lp_mode";
		qcom,mdss-dsi-off-command-state = "dsi_hs_mode";
		qcom,mdss-dsi-h-sync-pulse = <1>;
		qcom,mdss-dsi-traffic-mode = "burst_mode";
		qcom,mdss-dsi-lane-map = "lane_map_0123";
		qcom,mdss-dsi-bllp-eof-power-mode;
		qcom,mdss-dsi-bllp-power-mode;
		qcom,mdss-dsi-lane-0-state;
		qcom,mdss-dsi-lane-1-state;
		qcom,mdss-dsi-panel-timings = [7D 24 19 00 34 31 1D 26 2A 03 04 00];
		qcom,mdss-dsi-t-clk-post = <0x1F>;
		qcom,mdss-dsi-t-clk-pre = <0x2C>;
		qcom,mdss-dsi-dma-trigger = "trigger_sw";
		qcom,mdss-dsi-mdp-trigger = "none";
		qcom,mdss-dsi-reset-sequence = <1 20>, <0 20>, <1 20>;
		qcom,mdss-dsi-post-init-delay = <4>;
	};
};

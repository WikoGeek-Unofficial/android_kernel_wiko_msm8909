/* Copyright (c) 2013, The Linux Foundation. All rights reserved.
 *
 * This program is free software; you can redistribute it and/or modify
 * it under the terms of the GNU General Public License version 2 and
 * only version 2 as published by the Free Software Foundation.
 *
 * This program is distributed in the hope that it will be useful,
 * but WITHOUT ANY WARRANTY; without even the implied warranty of
 * MERCHANTABILITY or FITNESS FOR A PARTICULAR PURPOSE.  See the
 * GNU General Public License for more details.
 */

/*---------------------------------------------------------------------------
 * This file is autogenerated file using gcdb parser. Please do not edit it.
 * Update input XML file to add a new entry or update variable in this file
 * VERSION = "1.0"
 *---------------------------------------------------------------------------*/
&mdss_mdp {
	dsi_ili9881_boe_720p_video: qcom,mdss_dsi_ili9881_boe_720p_video {
		qcom,mdss-dsi-panel-name = "ili9881 boe 720p video mode dsi panel";
		qcom,mdss-dsi-panel-controller = <&mdss_dsi0>;
		qcom,mdss-dsi-panel-type = "dsi_video_mode";
		qcom,mdss-dsi-panel-destination = "display_1";
		qcom,mdss-dsi-panel-framerate = <60>;
		qcom,mdss-dsi-virtual-channel-id = <0>;
		qcom,mdss-dsi-stream = <0>;
		qcom,mdss-dsi-panel-width = <720>;
		qcom,mdss-dsi-panel-height = <1280>;
		qcom,mdss-dsi-h-front-porch = <62>; // 486mpbs yasuo h-porch
		qcom,mdss-dsi-h-back-porch = <64>;
		qcom,mdss-dsi-h-pulse-width = <8>;
		qcom,mdss-dsi-h-sync-skew = <0>;
		qcom,mdss-dsi-v-back-porch = <148>; 
		qcom,mdss-dsi-v-front-porch = <148>;
		qcom,mdss-dsi-v-pulse-width = <8>;
		qcom,mdss-dsi-h-left-border = <0>;
		qcom,mdss-dsi-h-right-border = <0>;
		qcom,mdss-dsi-v-top-border = <0>;
		qcom,mdss-dsi-v-bottom-border = <0>;
		qcom,mdss-dsi-bpp = <24>;
		qcom,mdss-dsi-color-order = "rgb_swap_rgb";
		qcom,mdss-dsi-underflow-color = <0xff>;
		qcom,mdss-dsi-border-color = <0>;
		qcom,mdss-dsi-on-command = [39 01 00 00 00 00 04 FF 98 81 03
			15 01 00 00 00 00 02 01 00
			15 01 00 00 00 00 02 02 00
			15 01 00 00 00 00 02 03 73
			15 01 00 00 00 00 02 04 00
			15 01 00 00 00 00 02 05 00
			15 01 00 00 00 00 02 06 08
			15 01 00 00 00 00 02 07 00
			15 01 00 00 00 00 02 08 00
			15 01 00 00 00 00 02 09 1B
			15 01 00 00 00 00 02 0A 01
			15 01 00 00 00 00 02 0B 01
			15 01 00 00 00 00 02 0C 0D
			15 01 00 00 00 00 02 0D 01
			15 01 00 00 00 00 02 0E 01
			15 01 00 00 00 00 02 0F 26
			15 01 00 00 00 00 02 10 26
			15 01 00 00 00 00 02 11 00
			15 01 00 00 00 00 02 12 00
			15 01 00 00 00 00 02 13 02
			15 01 00 00 00 00 02 14 00
			15 01 00 00 00 00 02 15 10
			15 01 00 00 00 00 02 16 10
			15 01 00 00 00 00 02 17 00
			15 01 00 00 00 00 02 18 00
			15 01 00 00 00 00 02 19 00
			15 01 00 00 00 00 02 1A 00
			15 01 00 00 00 00 02 1B 00
			15 01 00 00 00 00 02 1C 00
			15 01 00 00 00 00 02 1D 00
			15 01 00 00 00 00 02 1E 40
			15 01 00 00 00 00 02 1F C0
			15 01 00 00 00 00 02 20 06
			15 01 00 00 00 00 02 21 01
			15 01 00 00 00 00 02 22 06
			15 01 00 00 00 00 02 23 01
			15 01 00 00 00 00 02 24 88
			15 01 00 00 00 00 02 25 88
			15 01 00 00 00 00 02 26 00
			15 01 00 00 00 00 02 27 00
			15 01 00 00 00 00 02 28 3B
			15 01 00 00 00 00 02 29 03
			15 01 00 00 00 00 02 2A 00
			15 01 00 00 00 00 02 2B 00
			15 01 00 00 00 00 02 2C 00
			15 01 00 00 00 00 02 2D 00
			15 01 00 00 00 00 02 2E 00
			15 01 00 00 00 00 02 2F 00
			15 01 00 00 00 00 02 30 00
			15 01 00 00 00 00 02 31 00
			15 01 00 00 00 00 02 32 00
			15 01 00 00 00 00 02 33 00
			15 01 00 00 00 00 02 34 00
			15 01 00 00 00 00 02 35 00
			15 01 00 00 00 00 02 36 00
			15 01 00 00 00 00 02 37 00
			15 01 00 00 00 00 02 38 00
			15 01 00 00 00 00 02 39 00
			15 01 00 00 00 00 02 3A 00
			15 01 00 00 00 00 02 3B 00
			15 01 00 00 00 00 02 3C 00
			15 01 00 00 00 00 02 3D 00
			15 01 00 00 00 00 02 3E 00
			15 01 00 00 00 00 02 3F 00
			15 01 00 00 00 00 02 40 00
			15 01 00 00 00 00 02 41 00
			15 01 00 00 00 00 02 42 00
			15 01 00 00 00 00 02 43 00
			15 01 00 00 00 00 02 44 00
			15 01 00 00 00 00 02 50 01
			15 01 00 00 00 00 02 51 23
			15 01 00 00 00 00 02 52 45
			15 01 00 00 00 00 02 53 67
			15 01 00 00 00 00 02 54 89
			15 01 00 00 00 00 02 55 AB
			15 01 00 00 00 00 02 56 01
			15 01 00 00 00 00 02 57 23
			15 01 00 00 00 00 02 58 45
			15 01 00 00 00 00 02 59 67
			15 01 00 00 00 00 02 5A 89
			15 01 00 00 00 00 02 5B AB
			15 01 00 00 00 00 02 5C CD
			15 01 00 00 00 00 02 5D EF
			15 01 00 00 00 00 02 5E 11
			15 01 00 00 00 00 02 5F 02
			15 01 00 00 00 00 02 60 00
			15 01 00 00 00 00 02 61 0E
			15 01 00 00 00 00 02 62 0F
			15 01 00 00 00 00 02 63 0C
			15 01 00 00 00 00 02 64 0D
			15 01 00 00 00 00 02 65 02
			15 01 00 00 00 00 02 66 02
			15 01 00 00 00 00 02 67 02
			15 01 00 00 00 00 02 68 02
			15 01 00 00 00 00 02 69 02
			15 01 00 00 00 00 02 6A 02
			15 01 00 00 00 00 02 6B 02
			15 01 00 00 00 00 02 6C 02
			15 01 00 00 00 00 02 6D 02
			15 01 00 00 00 00 02 6E 05
			15 01 00 00 00 00 02 6F 05
			15 01 00 00 00 00 02 70 05
			15 01 00 00 00 00 02 71 05
			15 01 00 00 00 00 02 72 01
			15 01 00 00 00 00 02 73 06
			15 01 00 00 00 00 02 74 07
			15 01 00 00 00 00 02 75 02
			15 01 00 00 00 00 02 76 00
			15 01 00 00 00 00 02 77 0E
			15 01 00 00 00 00 02 78 0F
			15 01 00 00 00 00 02 79 0C
			15 01 00 00 00 00 02 7A 0D
			15 01 00 00 00 00 02 7B 02
			15 01 00 00 00 00 02 7C 02
			15 01 00 00 00 00 02 7D 02
			15 01 00 00 00 00 02 7E 02
			15 01 00 00 00 00 02 7F 02
			15 01 00 00 00 00 02 80 02
			15 01 00 00 00 00 02 81 02
			15 01 00 00 00 00 02 82 02
			15 01 00 00 00 00 02 83 02
			15 01 00 00 00 00 02 84 05
			15 01 00 00 00 00 02 85 05
			15 01 00 00 00 00 02 86 05
			15 01 00 00 00 00 02 87 05
			15 01 00 00 00 00 02 88 01
			15 01 00 00 00 00 02 89 06
			15 01 00 00 00 00 02 8A 07
			39 01 00 00 00 00 04 FF 98 81 04
			15 01 00 00 00 00 02 00 80
			15 01 00 00 00 00 02 3B 80
			15 01 00 00 00 00 02 6C 15
			15 01 00 00 00 00 02 6E 1A
			15 01 00 00 00 00 02 6F 25
			15 01 00 00 00 00 02 8D 1F
			15 01 00 00 00 00 02 87 BA
			15 01 00 00 00 00 02 7A 10
			15 01 00 00 00 00 02 71 B0
			15 01 00 00 00 00 02 3A 24
			15 01 00 00 00 00 02 6C 13	 //VCORE=1.4v decrease
			15 01 00 00 00 00 02 AF 33   //ADD crrent bias decrease
			15 01 00 00 00 00 02 35 1F
			15 01 00 00 00 00 02 3B 9F   //pumping delay		
			39 01 00 00 00 00 04 FF 98 81 01
			15 01 00 00 00 00 02 22 0A
			15 01 00 00 00 00 02 31 00
			15 01 00 00 00 00 02 40 33
			15 01 00 00 00 00 02 43 33   //66    4003 decrease 33
			15 01 00 00 00 00 02 50 85
			15 01 00 00 00 00 02 51 82
			15 01 00 00 00 00 02 60 19
			15 01 00 00 00 00 02 61 01
			15 01 00 00 00 00 02 62 0C
			15 01 00 00 00 00 02 63 00
			15 01 00 00 00 00 02 A0 00
			15 01 00 00 00 00 02 A1 19
			15 01 00 00 00 00 02 A2 28
			15 01 00 00 00 00 02 A3 13
			15 01 00 00 00 00 02 A4 16
			15 01 00 00 00 00 02 A5 28
			15 01 00 00 00 00 02 A6 1C
			15 01 00 00 00 00 02 A7 1E
			15 01 00 00 00 00 02 A8 87
			15 01 00 00 00 00 02 A9 1D
			15 01 00 00 00 00 02 AA 2A
			15 01 00 00 00 00 02 AB 73
			15 01 00 00 00 00 02 AC 18
			15 01 00 00 00 00 02 AD 15
			15 01 00 00 00 00 02 AE 47
			15 01 00 00 00 00 02 AF 1B
			15 01 00 00 00 00 02 B0 24
			15 01 00 00 00 00 02 B1 4C
			15 01 00 00 00 00 02 B2 5E
			15 01 00 00 00 00 02 B3 39
			15 01 00 00 00 00 02 C0 00
			15 01 00 00 00 00 02 C1 19
			15 01 00 00 00 00 02 C2 28
			15 01 00 00 00 00 02 C3 13
			15 01 00 00 00 00 02 C4 16
			15 01 00 00 00 00 02 C5 28
			15 01 00 00 00 00 02 C6 1C
			15 01 00 00 00 00 02 C7 1E
			15 01 00 00 00 00 02 C8 87
			15 01 00 00 00 00 02 C9 1D
			15 01 00 00 00 00 02 CA 2A
			15 01 00 00 00 00 02 CB 73
			15 01 00 00 00 00 02 CC 18
			15 01 00 00 00 00 02 CD 15
			15 01 00 00 00 00 02 CE 47
			15 01 00 00 00 00 02 CF 1B
			15 01 00 00 00 00 02 D0 24
			15 01 00 00 00 00 02 D1 4C
			15 01 00 00 00 00 02 D2 5E
			15 01 00 00 00 00 02 D3 39
			39 01 00 00 00 00 04 FF 98 81 00
			15 01 00 00 00 00 02 36 00
			15 01 00 00 00 00 02 34 00
			15 01 00 00 96 00 02 11 00
			15 01 00 00 1e 00 02 29 00
               	];
		qcom,mdss-dsi-off-command = [05 01 00 00 32 00 02 28 00
					                            05 01 00 00 78 00 02 10 00];
		qcom,mdss-dsi-on-command-state = "dsi_lp_mode";
		qcom,mdss-dsi-off-command-state = "dsi_lp_mode";
		qcom,mdss-dsi-panel-status-command = [06 01 00 01 05 00 02 0a 08];
		qcom,mdss-dsi-panel-status-command-state = "dsi_hs_mode";
		qcom,mdss-dsi-panel-status-check-mode = "reg_read";
		qcom,mdss-dsi-panel-status-value = <0x9c>;
              qcom,esd-check-enabled;
		qcom,mdss-dsi-h-sync-pulse = <1>;
		qcom,mdss-dsi-traffic-mode = "burst_mode";
		qcom,mdss-dsi-lane-map = "lane_map_0123";
		qcom,mdss-dsi-bllp-eof-power-mode;
		qcom,mdss-dsi-bllp-power-mode;
		qcom,mdss-dsi-lane-0-state;
		qcom,mdss-dsi-lane-1-state;
		qcom,mdss-dsi-lane-2-state;
		qcom,mdss-dsi-lane-3-state;
		qcom,mdss-dsi-panel-timings = [9b 1F 1c 00 44 48 18 1F 19 03 04 00];
		qcom,mdss-dsi-t-clk-post = <0x04>;
		qcom,mdss-dsi-t-clk-pre = <0x1C>;
		qcom,mdss-dsi-bl-min-level = <1>;
		qcom,mdss-dsi-bl-max-level = <255>;
		qcom,mdss-dsi-dma-trigger = "trigger_sw";
		qcom,mdss-dsi-mdp-trigger = "none";
		qcom,mdss-dsi-bl-pmic-control-type = "bl_ctrl_pwm";
		qcom,mdss-dsi-bl-pmic-pwm-frequency = <30>; // 10KHz to 37.5KHz 
		qcom,mdss-dsi-bl-pmic-bank-select = <0>;
		qcom,mdss-dsi-reset-sequence = <1 10>, <0 10>, <1 120>;
	};
};
